## layers/meta-balena-allwinner/conf/machine/olimex-a20-negotica.conf
```bitbake
#@TYPE: Machine
#@NAME: Olimex A20 Negotica
#@DESCRIPTION: Machine configuration for the Olimex A20 Negotica Board, based on Allwinner A20 CPU
#https://www.negotica.net

require conf/machine/include/sun7i.inc

KERNEL_DEVICETREE = "sun7i-a20-olimex-som-negotica.dtb"
UBOOT_MACHINE = "A20-Olimex-SOM-negotica_defconfig"
```
